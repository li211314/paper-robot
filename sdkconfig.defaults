## sdkconfig.defaults
```kconfig
CONFIG_FREERTOS_HZ=1000
CONFIG_ESP_MAIN_TASK_STACK_SIZE=4096
CONFIG_LOG_DEFAULT_LEVEL_INFO=y

CONFIG_I2C_INTERFACE=y
CONFIG_SSD1306_128x64=y
CONFIG_OFFSETX=0
CONFIG_SDA_GPIO=0
CONFIG_SCL_GPIO=1
CONFIG_RESET_GPIO=-1
CONFIG_I2C_PORT_0=y
CONFIG_LEGACY_DRIVER=n
```
